## overlay/Config.in
```kconfig
source "$BR2_EXTERNAL_monitorOverlay_PATH/package/zabbix/Config.in"
source "$BR2_EXTERNAL_monitorOverlay_PATH/package/rodos/Config.in"
source "$BR2_EXTERNAL_monitorOverlay_PATH/package/manuals/Config.in"
```

## overlay/configs/beaglebone_defconfig
```kconfig
BR2_arm=y
BR2_cortex_a8=y
BR2_DL_DIR="~/dl"
BR2_PACKAGE_OVERRIDE_FILE=""
BR2_TOOLCHAIN_EXTERNAL=y
BR2_INIT_SYSTEMD=y
BR2_TARGET_GENERIC_ROOT_PASSWD="admin"
BR2_SYSTEM_BIN_SH_BASH=y
BR2_TARGET_GENERIC_GETTY_PORT="tty1"
BR2_SYSTEM_DHCP="eth0"
BR2_SYSTEM_ENABLE_NLS=y
BR2_TARGET_TZ_ZONELIST="europe"
BR2_TARGET_LOCALTIME="Europe/Moscow"
BR2_ROOTFS_POST_BUILD_SCRIPT="$(BR2_EXTERNAL_alexeyOverlay_PATH)/board/beaglebone/inside-fakeroot.sh "
BR2_ROOTFS_POST_IMAGE_SCRIPT="$(BR2_EXTERNAL_alexeyOverlay_PATH)/board/beaglebone/sdcard.sh"
BR2_LINUX_KERNEL=y
BR2_LINUX_KERNEL_USE_CUSTOM_CONFIG=y
BR2_LINUX_KERNEL_CUSTOM_CONFIG_FILE="$(BR2_EXTERNAL_alexeyOverlay_PATH)/board/beaglebone/linux_defconfig"
BR2_LINUX_KERNEL_DTS_SUPPORT=y
BR2_LINUX_KERNEL_INTREE_DTS_NAME="am335x-evm am335x-bone am335x-boneblack am335x-evmsk"
BR2_LINUX_KERNEL_NEEDS_HOST_OPENSSL=y
BR2_PACKAGE_E2FSPROGS=y
BR2_PACKAGE_E2FSPROGS_RESIZE2FS=y
BR2_PACKAGE_DIRECTFB=y
# BR2_PACKAGE_DIRECTFB_PS2MOUSE is not set
# BR2_PACKAGE_DIRECTFB_SERIALMOUSE is not set
# BR2_PACKAGE_DIRECTFB_TSLIB is not set
# BR2_PACKAGE_DIRECTFB_GIF is not set
# BR2_PACKAGE_DIRECTFB_JPEG is not set
# BR2_PACKAGE_DIRECTFB_PNG is not set
# BR2_PACKAGE_DIRECTFB_SVG is not set
BR2_PACKAGE_LSHW=y
BR2_PACKAGE_USBUTILS=y
BR2_PACKAGE_PHP=y
BR2_PACKAGE_PHP_SAPI_CGI=y
BR2_PACKAGE_PHP_SAPI_FPM=y
BR2_PACKAGE_PHP_EXT_OPENSSL=y
BR2_PACKAGE_PHP_EXT_MYSQLI=y
BR2_PACKAGE_PHP_EXT_GETTEXT=y
BR2_PACKAGE_PHP_EXT_ICONV=y
BR2_PACKAGE_PHP_EXT_MBSTRING=y
BR2_PACKAGE_PHP_EXT_GD=y
BR2_PACKAGE_PHP_EXT_BCMATH=y
BR2_PACKAGE_PHP_EXT_CURL=y
BR2_PACKAGE_PHP_EXT_SOCKETS=y
BR2_PACKAGE_PHP_EXT_CTYPE=y
BR2_PACKAGE_PHP_EXT_XMLREADER=y
BR2_PACKAGE_PHP_EXT_XMLWRITER=y
BR2_PACKAGE_LIBOPENSSL_BIN=y
BR2_PACKAGE_LIBOPENSSL_ENGINES=y
BR2_PACKAGE_MYSQL=y
BR2_PACKAGE_ORACLE_MYSQL_SERVER=y
BR2_PACKAGE_HIDAPI=y
BR2_PACKAGE_LIBHID=y
BR2_PACKAGE_LIBPHIDGET=y
BR2_PACKAGE_LIBEVENT=y
BR2_PACKAGE_DROPBEAR=y
BR2_PACKAGE_DROPBEAR_DISABLE_REVERSEDNS=y
BR2_PACKAGE_LIGHTTPD=y
BR2_PACKAGE_LIGHTTPD_OPENSSL=y
BR2_PACKAGE_LIGHTTPD_PCRE=y
BR2_PACKAGE_NETSNMP=y
BR2_PACKAGE_BASH_COMPLETION=y
# BR2_PACKAGE_SYSTEMD_HWDB is not set
BR2_PACKAGE_SYSTEMD_LOCALED=y
BR2_PACKAGE_SYSTEMD_LOGIND=y
BR2_PACKAGE_SYSTEMD_POLKIT=y
BR2_PACKAGE_SYSTEMD_SYSUSERS=y
BR2_PACKAGE_NANO=y
BR2_TARGET_ROOTFS_INITRAMFS=y
BR2_TARGET_ROOTFS_SQUASHFS=y
# BR2_TARGET_ROOTFS_TAR is not set
BR2_TARGET_UBOOT=y
BR2_TARGET_UBOOT_BUILD_SYSTEM_KCONFIG=y
BR2_TARGET_UBOOT_CUSTOM_VERSION=y
BR2_TARGET_UBOOT_CUSTOM_VERSION_VALUE="2018.07"
BR2_TARGET_UBOOT_BOARD_DEFCONFIG="am335x_boneblack_vboot"
BR2_TARGET_UBOOT_NEEDS_DTC=y
BR2_TARGET_UBOOT_NEEDS_OPENSSL=y
# BR2_TARGET_UBOOT_FORMAT_BIN is not set
BR2_TARGET_UBOOT_FORMAT_IMG=y
BR2_TARGET_UBOOT_SPL=y
BR2_TARGET_UBOOT_SPL_NAME="MLO"
BR2_PACKAGE_HOST_DOSFSTOOLS=y
BR2_PACKAGE_HOST_E2FSPROGS=y
BR2_PACKAGE_HOST_GENEXT2FS=y
BR2_PACKAGE_HOST_GENIMAGE=y
BR2_PACKAGE_HOST_MTOOLS=y
BR2_PACKAGE_HOST_UBOOT_TOOLS=y
BR2_PACKAGE_HOST_UBOOT_TOOLS_FIT_SUPPORT=y
```

## overlay/configs/my_x86-64_defconfig
```kconfig
BR2_x86_64=y
BR2_DL_DIR="~/dl"
BR2_PACKAGE_OVERRIDE_FILE=""
BR2_TOOLCHAIN_BUILDROOT_GLIBC=y
BR2_TOOLCHAIN_BUILDROOT_CXX=y
BR2_TARGET_GENERIC_HOSTNAME="1.2b"
BR2_TARGET_GENERIC_ISSUE="System starting,please wait"
BR2_INIT_SYSTEMD=y
BR2_TARGET_GENERIC_ROOT_PASSWD="admin"
BR2_SYSTEM_BIN_SH_BASH=y
BR2_TARGET_GENERIC_GETTY_PORT="tty1"
BR2_SYSTEM_DHCP="eth0"
BR2_ENABLE_LOCALE_WHITELIST="C en_US ru_RU"
BR2_GENERATE_LOCALE="ru_RU.UTF-8"
BR2_TARGET_LOCALTIME="Europe/Moscow"
BR2_ROOTFS_OVERLAY="$(BR2_EXTERNAL_monitorOverlay_PATH)/rootfs_overlay/"
BR2_ROOTFS_POST_BUILD_SCRIPT="$(BR2_EXTERNAL_monitorOverlay_PATH)/post-build.sh "
BR2_ROOTFS_POST_IMAGE_SCRIPT="$(BR2_EXTERNAL_monitorOverlay_PATH)/board/x86_64/sdcard.sh"
BR2_LINUX_KERNEL=y
BR2_LINUX_KERNEL_USE_CUSTOM_CONFIG=y
BR2_LINUX_KERNEL_CUSTOM_CONFIG_FILE="$(BR2_EXTERNAL_monitorOverlay_PATH)/board/x86_64/linux_config"
BR2_LINUX_KERNEL_NEEDS_HOST_OPENSSL=y
BR2_PACKAGE_E2FSPROGS=y
BR2_PACKAGE_E2FSPROGS_RESIZE2FS=y
BR2_PACKAGE_DIRECTFB=y
# BR2_PACKAGE_DIRECTFB_PS2MOUSE is not set
# BR2_PACKAGE_DIRECTFB_SERIALMOUSE is not set
# BR2_PACKAGE_DIRECTFB_TSLIB is not set
# BR2_PACKAGE_DIRECTFB_GIF is not set
# BR2_PACKAGE_DIRECTFB_JPEG is not set
# BR2_PACKAGE_DIRECTFB_PNG is not set
# BR2_PACKAGE_DIRECTFB_SVG is not set
BR2_PACKAGE_INTEL_MICROCODE=y
BR2_PACKAGE_LSHW=y
BR2_PACKAGE_SYSSTAT=y
BR2_PACKAGE_USBUTILS=y
BR2_PACKAGE_PHP=y
BR2_PACKAGE_PHP_SAPI_CGI=y
BR2_PACKAGE_PHP_SAPI_FPM=y
BR2_PACKAGE_PHP_EXT_HASH=y
BR2_PACKAGE_PHP_EXT_OPENSSL=y
BR2_PACKAGE_PHP_EXT_PGSQL=y
BR2_PACKAGE_PHP_EXT_GETTEXT=y
BR2_PACKAGE_PHP_EXT_ICONV=y
BR2_PACKAGE_PHP_EXT_MBSTRING=y
BR2_PACKAGE_PHP_EXT_GD=y
BR2_PACKAGE_PHP_EXT_BCMATH=y
BR2_PACKAGE_PHP_EXT_CURL=y
BR2_PACKAGE_PHP_EXT_SNMP=y
BR2_PACKAGE_PHP_EXT_SOCKETS=y
BR2_PACKAGE_PHP_EXT_CTYPE=y
BR2_PACKAGE_PHP_EXT_FILTER=y
BR2_PACKAGE_PHP_EXT_XMLREADER=y
BR2_PACKAGE_PHP_EXT_XMLWRITER=y
BR2_PACKAGE_LIBARCHIVE=y
BR2_PACKAGE_LIBARCHIVE_BSDTAR=y
BR2_PACKAGE_LIBOPENSSL_BIN=y
BR2_PACKAGE_LIBOPENSSL_ENGINES=y
BR2_PACKAGE_HIDAPI=y
BR2_PACKAGE_LIBHID=y
BR2_PACKAGE_LIBPHIDGET=y
BR2_PACKAGE_CURL=y
BR2_PACKAGE_LIBCURL_VERBOSE=y
BR2_PACKAGE_SNMPPP=y
BR2_PACKAGE_DROPBEAR=y
BR2_PACKAGE_DROPBEAR_DISABLE_REVERSEDNS=y
BR2_PACKAGE_LIGHTTPD=y
BR2_PACKAGE_LIGHTTPD_OPENSSL=y
BR2_PACKAGE_LIGHTTPD_PCRE=y
BR2_PACKAGE_BASH_COMPLETION=y
BR2_PACKAGE_LOGROTATE=y
BR2_PACKAGE_SUDO=y
# BR2_PACKAGE_SYSTEMD_HWDB is not set
BR2_PACKAGE_SYSTEMD_LOCALED=y
BR2_PACKAGE_SYSTEMD_LOGIND=y
BR2_PACKAGE_SYSTEMD_POLKIT=y
BR2_PACKAGE_SYSTEMD_SYSUSERS=y
BR2_PACKAGE_NANO=y
BR2_TARGET_ROOTFS_INITRAMFS=y
# BR2_TARGET_ROOTFS_TAR is not set
BR2_TARGET_GRUB2=y
BR2_PACKAGE_HOST_DOSFSTOOLS=y
BR2_PACKAGE_HOST_E2FSPROGS=y
BR2_PACKAGE_HOST_GENEXT2FS=y
BR2_PACKAGE_HOST_GENIMAGE=y
BR2_PACKAGE_HOST_MTOOLS=y
BR2_PACKAGE_HOST_UBOOT_TOOLS=y
BR2_PACKAGE_HOST_UBOOT_TOOLS_FIT_SUPPORT=y
BR2_PACKAGE_ZABBIX=y
BR2_PACKAGE_ZABBIX_SERVER=y
BR2_PACKAGE_ZABBIX_SERVER_COPY_DUMPS=y
BR2_PACKAGE_ZABBIX_SERVER_COPY_FRONTEND=y
BR2_PACKAGE_RODOS=y
BR2_PACKAGE_MANUALS=y
```

## overlay/package/manuals/Config.in
```kconfig
config BR2_PACKAGE_MANUALS
	bool "manuals"
	  help
	  create pdf and html manuals 
```

## overlay/package/rodos/Config.in
```kconfig
config BR2_PACKAGE_RODOS
	bool "rodos"
	select BR2_PACKAGE_LIBUSB
	  help
	  rodos 5-6 usb termometer software
```

## overlay/package/zabbix/Config.in
```kconfig
config BR2_PACKAGE_ZABBIX
	bool "zabbix"
	depends on BR2_TOOLCHAIN_USES_GLIBC=y || BR2_TOOLCHAIN_EXTERNAL_GLIBC=y || BR2_TOOLCHAIN_EXTERNAL_CUSTOM_GLIBC=y
	select BR2_PACKAGE_PCRE
	help
	  Zabbix is an enterprise-class open source distributed
	  monitoring solution.Zabbix is free of cost. Zabbix
	  is written and distributed under the GPL General Public
	  License version 2.

if (!BR2_TOOLCHAIN_USES_GLIBC && !BR2_TOOLCHAIN_EXTERNAL_GLIBC && !BR2_TOOLCHAIN_EXTERNAL_CUSTOM_GLIBC)
comment "zabbix need glibc"
endif

if BR2_PACKAGE_ZABBIX

if (!BR2_PACKAGE_POSTGRESQL && !BR2_PACKAGE_MYSQL)
comment "zabbix server needs postgresql or mysql support"
endif

config BR2_PACKAGE_ZABBIX_SERVER
	bool "zabbix server"
	depends on BR2_PACKAGE_POSTGRESQL || BR2_PACKAGE_MYSQL
	select BR2_PACKAGE_ZLIB
	select BR2_PACKAGE_LIBEVENT

if BR2_PACKAGE_ZABBIX_SERVER

choice
	prompt "server database backend"

config BR2_PACKAGE_ZABBIX_SERVER_MYSQL
	bool "mysql"
	depends on BR2_PACKAGE_MYSQL

config BR2_PACKAGE_ZABBIX_SERVER_POSTGRESQL
	bool "postgresql"
	depends on BR2_PACKAGE_POSTGRESQL

endchoice

if BR2_PACKAGE_ZABBIX_SERVER_POSTGRESQL || BR2_PACKAGE_ZABBIX_SERVER_MYSQL
config BR2_PACKAGE_ZABBIX_SERVER_COPY_DUMPS
	bool "install sql dumps"
	help
	  Copy inicitial database dumps to /usr/zabbix/
endif

if (!BR2_PACKAGE_PHP || (!BR2_PACKAGE_PHP_EXT_MYSQLI && !BR2_PACKAGE_PHP_EXT_PGSQL) || \
	!BR2_PACKAGE_PHP_EXT_MBSTRING || !BR2_PACKAGE_PHP_EXT_BCMATH || \
	!BR2_PACKAGE_PHP_EXT_SOCKETS || !BR2_PACKAGE_PHP_EXT_GD || \
	!BR2_PACKAGE_PHP_EXT_LIBXML2 || !BR2_PACKAGE_PHP_EXT_CTYPE || \
	!BR2_PACKAGE_PHP_EXT_SESSION || !BR2_PACKAGE_PHP_EXT_XMLREADER || \
	!BR2_PACKAGE_PHP_EXT_XMLWRITER )
comment "zabbix-frontend need php with extensions(bc,sockets,"
comment "mbstring,gd,libxml2,ctype,session, xmlreader,xmlwriter, mysql or postgresql"
endif

choice
	prompt "server ssl/tls backend"

config BR2_PACKAGE_ZABBIX_SERVER_NOTLS
	bool "none"

config BR2_PACKAGE_ZABBIX_SERVER_OPENSSL
	bool "openssl"
	depends on BR2_PACKAGE_OPENSSL

config BR2_PACKAGE_ZABBIX_SERVER_GNUTLS
	bool "gnutls"
	depends on BR2_PACKAGE_GNUTLS

endchoice

config BR2_PACKAGE_ZABBIX_SERVER_OPENIPMI
	bool "openipmi support"
	select BR2_PACKAGE_OPENIPMI

config BR2_PACKAGE_ZABBIX_SERVER_LIBSSH2
	bool "libssh2 support"
	select BR2_PACKAGE_LIBSSH2

config BR2_PACKAGE_ZABBIX_SERVER_LDAP
	bool "openldap support"
	select BR2_PACKAGE_OPENLDAP

if (!BR2_USE_MMU)
comment "netsnmp support need MMU"
endif

config BR2_PACKAGE_ZABBIX_SERVER_NETSNMP
	bool "net-snmp support"
	depends on BR2_USE_MMU # netsnmp
	select BR2_PACKAGE_NETSNMP

config BR2_PACKAGE_ZABBIX_SERVER_LIBCURL
	bool "libcurl support"
	select BR2_PACKAGE_LIBCURL

config BR2_PACKAGE_ZABBIX_SERVER_LIBXML2
	bool "libxml2 support"
	select BR2_PACKAGE_LIBXML2

config BR2_PACKAGE_ZABBIX_SERVER_COPY_FRONTEND
	bool "copy php-frontend to target"
	depends on BR2_PACKAGE_PHP
	depends on BR2_PACKAGE_PHP_EXT_MYSQLI || BR2_PACKAGE_PHP_EXT_PGSQL
	depends on BR2_PACKAGE_PHP_EXT_BCMATH
	depends on BR2_PACKAGE_PHP_EXT_SOCKETS
	depends on BR2_PACKAGE_PHP_EXT_MBSTRING
	depends on BR2_PACKAGE_PHP_EXT_GD
	depends on BR2_PACKAGE_PHP_EXT_LIBXML2
	depends on BR2_PACKAGE_PHP_EXT_CTYPE
	depends on BR2_PACKAGE_PHP_EXT_SESSION
	depends on BR2_PACKAGE_PHP_EXT_XMLREADER
	depends on BR2_PACKAGE_PHP_EXT_XMLWRITER
	help
	  copy web-frontend to /usr/zabbix/php-frontend

endif

endif
```
